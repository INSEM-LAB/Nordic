## NCS200_SLM_ADC_nrf9160dk/src/adc/Kconfig
```kconfig
#
# Copyright (c) 2021 Nordic Semiconductor ASA
#
# SPDX-License-Identifier: LicenseRef-Nordic-5-Clause

config SLM_ADC
	bool "ADC support in SLM"
	default n
	depends on ADC
```
